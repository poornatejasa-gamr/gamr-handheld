## idf-env/sdkconfig.defaults
```kconfig
CONFIG_IDF_TARGET="esp32s3"
CONFIG_ESPTOOLPY_FLASHSIZE_8MB=y
CONFIG_PARTITION_TABLE_CUSTOM=y
CONFIG_PARTITION_TABLE_CUSTOM_FILENAME="idf-env/partitions.csv"
CONFIG_BOOTLOADER_APP_ROLLBACK_ENABLE=y
```
